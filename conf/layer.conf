## conf/layer.conf
```bitbake
# We have a conf and classes directory, add to BBPATH
BBPATH .= ":${LAYERDIR}"

# We have recipes-* directories, add to BBFILES
BBFILES += "${LAYERDIR}/recipes-*/*/*.bb \
            ${LAYERDIR}/recipes-*/*/*.bbappend"

BBFILE_COLLECTIONS += "/home/build/shared/meta-xmz"
BBFILE_PATTERN_/home/build/shared/meta-xmz = "^${LAYERDIR}/"
BBFILE_PRIORITY_/home/build/shared/meta-xmz = "6"
```
